// RamePlayer CID6: Real-Time Clock (DS1307 I2C RTC)
//
// Based on Linux kernel file: arch/arm/boot/dts/overlays/i2c-rtc-overlay.dts
// - TinyRTC module w/EEPROM is connected to i2c0 on Raspberry Pi 2

/dts-v1/;
/plugin/;


/ {
	// Raspberry Pi 2
	compatible = "brcm,bcm2709";

	fragment@0 {
		target = <&i2c0>;
		__overlay__ {
			#address-cells = <1>;
			#size-cells = <0>;
			status = "okay";

			ramertc: ramertc@68 {
				compatible = "maxim,ds1307";
				reg = <0x68>;
				status = "okay";
			};
		}; // __overlay__
	}; // fragment
};
