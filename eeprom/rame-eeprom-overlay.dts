// ---------------------------------------------------------------------------
// RamePlayer EEPROM device tree overlay
// For: product_id 0x0001 / product_ver 0x0002
// ---------------------------------------------------------------------------

/dts-v1/;
/plugin/;


/ {
	// Raspberry Pi 2
	compatible = "brcm,bcm2709";

	// Rame hardware info
	fragment@0 {
		target-path = "/";
		__overlay__ {
			rame {
				hardware = "RamePlayer chassis 1.0";
				eeprom-cids = "3,4,5,6"; // r2kbd,lcd,audio,rtc
			};
		}; // overlay
	}; // fragment
}; // /
